## tiny/Kconfig
```kconfig
mainmenu "Main Menu"

config CONF_PATH
    string "Default config path"
    default "configs/default.config"
    help
    ┊ set default config


comment "This item is visible only if the third option is selected"

config APP1
    bool "Open APP1 feature"
    default n
```
